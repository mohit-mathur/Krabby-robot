## sdkconfig.defaults
```kconfig
CONFIG_IDF_TARGET="esp32s3"
CONFIG_ESP_CONSOLE_USB_SERIAL_JTAG=y
CONFIG_ESPTOOLPY_FLASHSIZE_2MB=y

# WiFi
CONFIG_ESP_WIFI_SSID="QuadrupedBot"
CONFIG_ESP_WIFI_PASSWORD="robot1234"
CONFIG_ESP_WIFI_CHANNEL=1
CONFIG_ESP_MAX_STA_CONN=4
CONFIG_ESP_WIFI_TASK_CORE_ID=0

# HTTP Server
CONFIG_HTTPD_MAX_REQ_HDR_LEN=1024
CONFIG_HTTPD_MAX_URI_LEN=512
```
